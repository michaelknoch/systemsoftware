## V4/modul-package/Config.in
```kconfig
config BR2_PACKAGE_SYSO
	bool "syso"
	help
	  All Syso Packages


if BR2_PACKAGE_SYSO
    menu "Verschiedene Sachen"
        source "package/syso/template/Config.in"
	source "package/syso/openclose/Config.in"
    endmenu

endif
```

## V4/modul-package/access/Config.in
```kconfig
config BR2_PACKAGE_ACCESS
	bool "access"
	help
	  buga buga
	  http://tucktuck.org/tucktucktemplate/
```

## V4/modul-package/mynull/Config.in
```kconfig
config BR2_PACKAGE_MYNULL
	bool "mynull"
	help
	  This is a comment that explains what mynull is.
	  http://tucktuck.org/tucktucktemplate/
```

## V4/modul-package/myzero/Config.in
```kconfig
config BR2_PACKAGE_MYZERO
	bool "myzero"
	help
	  This is a comment that explains what myzero is.
	  http://tucktuck.org/tucktucktemplate/
```

## V4/modul-package/template/Config.in
```kconfig
config BR2_PACKAGE_TEMPLATE
        bool "template"
        help
          This is a comment that explains what template is.

          http://tucktuck.org/tucktucktemplate/
```

## V5/modul-package/Config.in
```kconfig
config BR2_PACKAGE_SYSO
	bool "syso"
	help
	  All Syso Packages


if BR2_PACKAGE_SYSO
    menu "Verschiedene Sachen"
        source "package/syso/template/Config.in"
		source "package/syso/kthread/Config.in"
		source "package/syso/access/Config.in"
		source "package/syso/buf/Config.in"
		source "package/syso/myzero/Config.in"
    endmenu

endif
```

## V5/modul-package/kthread/Config.in
```kconfig
config BR2_PACKAGE_KTHREAD
	bool "kthread"
	help
	  This is a comment that explains what kthread is.
	  http://tucktuck.org/tucktucktemplate/
```

## V5/modul-package/lock/Config.in
```kconfig
config BR2_PACKAGE_MYNULL
	bool "lock"
	help
	  This is a comment that explains what lock is.
	  http://tucktuck.org/tucktucktemplate/
```

## V5/modul-package/open_once/Config.in
```kconfig
config BR2_PACKAGE_OPEN_ONCE
	bool "open_once"
	help
	  This is a comment that explains what open_once is.
	  http://tucktuck.org/tucktucktemplate/
```

## V5/modul-package/tasklet/Config.in
```kconfig
config BR2_PACKAGE_TASKLET
	bool "tasklet"
	help
	  This is a comment that explains what tasklet is.
	  http://tucktuck.org/tucktucktemplate/
```

## V5/modul-package/timer/Config.in
```kconfig
config BR2_PACKAGE_TIMER
	bool "timer"
	help
	  This is a comment that explains what timer is.
	  http://tucktuck.org/tucktucktemplate/
```

## V5/modul-package/wq/Config.in
```kconfig
config BR2_PACKAGE_WQ
	bool "wq"
	help
	  This is a comment that explains what wq is.
	  http://tucktuck.org/tucktucktemplate/
```
